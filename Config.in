## Config.in
```kconfig
source "$BR2_EXTERNAL_SUPERDUPERBIRD_PATH/package/memory-game/Config.in"
source "$BR2_EXTERNAL_SUPERDUPERBIRD_PATH/package/libmali/Config.in"
source "$BR2_EXTERNAL_SUPERDUPERBIRD_PATH/package/wayland-old/Config.in"
source "$BR2_EXTERNAL_SUPERDUPERBIRD_PATH/package/libffi-old/Config.in"
```

## configs/superduperbird_defconfig
```kconfig
BR2_aarch64=y
BR2_TOOLCHAIN_EXTERNAL=y
BR2_TOOLCHAIN_EXTERNAL_CUSTOM=y
BR2_TOOLCHAIN_EXTERNAL_PATH="$(BR2_EXTERNAL_SUPERDUPERBIRD_PATH)/toolchain/aarch64-linux-gnu"
BR2_TOOLCHAIN_EXTERNAL_CUSTOM_PREFIX="aarch64-linux-gnu"
BR2_TOOLCHAIN_EXTERNAL_GCC_4_9=y
BR2_TOOLCHAIN_EXTERNAL_HEADERS_4_0=y
BR2_TOOLCHAIN_EXTERNAL_CUSTOM_GLIBC=y
BR2_TOOLCHAIN_EXTERNAL_CXX=y
BR2_TOOLCHAIN_EXTERNAL_FORTRAN=y
BR2_TOOLCHAIN_EXTERNAL_OPENMP=y
BR2_TOOLCHAIN_EXTERNAL_GDB_SERVER_COPY=y
BR2_TARGET_GENERIC_HOSTNAME="superduperbird"
BR2_TARGET_GENERIC_ISSUE="Welcome to Superduperbird"
BR2_ROOTFS_DEVICE_CREATION_DYNAMIC_EUDEV=y
BR2_TARGET_GENERIC_ROOT_PASSWD="superduperbird"
BR2_ROOTFS_OVERLAY="$(BR2_EXTERNAL_SUPERDUPERBIRD_PATH)/board/rootfs-overlay"
BR2_ROOTFS_POST_BUILD_SCRIPT="$(BR2_EXTERNAL_SUPERDUPERBIRD_PATH)/board/post_build.sh"
BR2_ROOTFS_POST_IMAGE_SCRIPT="$(BR2_EXTERNAL_SUPERDUPERBIRD_PATH)/board/post_image.sh"
BR2_LINUX_KERNEL=y
BR2_LINUX_KERNEL_CUSTOM_GIT=y
BR2_LINUX_KERNEL_CUSTOM_REPO_URL="https://github.com/nd-0r/kernel-common.git"
BR2_LINUX_KERNEL_CUSTOM_REPO_VERSION="buildroot-openlinux-201904-g12a"
BR2_LINUX_KERNEL_CUSTOM_REPO_GIT_SUBMODULES=y
BR2_LINUX_KERNEL_USE_CUSTOM_CONFIG=y
BR2_LINUX_KERNEL_CUSTOM_CONFIG_FILE="$(BR2_EXTERNAL_SUPERDUPERBIRD_PATH)/board/linux.config"
BR2_PACKAGE_SDL2=y
BR2_PACKAGE_DBUS=y
BR2_PACKAGE_EUDEV_RULES_GEN=y
BR2_PACKAGE_LIBDRM=y
BR2_PACKAGE_LIBDISPLAY_INFO=y
BR2_PACKAGE_LIBXKBCOMMON=y
BR2_PACKAGE_LIBXKBCOMMON_TOOLS=y
BR2_PACKAGE_OPENSSH=y
BR2_PACKAGE_HOST_BTRFS_PROGS=y
BR2_PACKAGE_HOST_E2FSPROGS=y
BR2_PACKAGE_HOST_SQUASHFS=y
```

## configs/superduperbird_dev_defconfig
```kconfig
BR2_aarch64=y
BR2_PACKAGE_HOST_LINUX_HEADERS_CUSTOM_4_9=y
BR2_TOOLCHAIN_BUILDROOT_CXX=y
BR2_PACKAGE_HOST_GDB=y
BR2_PACKAGE_HOST_GDB_TUI=y
BR2_PACKAGE_HOST_GDB_PYTHON3=y
BR2_PACKAGE_HOST_GDB_SIM=y
BR2_GDB_VERSION_14=y
BR2_ENABLE_DEBUG=y
BR2_DEBUG_3=y
BR2_ENABLE_RUNTIME_DEBUG=y
BR2_TARGET_GENERIC_HOSTNAME="superduperbird"
BR2_TARGET_GENERIC_ISSUE="Welcome to Superduperbird"
BR2_ROOTFS_DEVICE_CREATION_DYNAMIC_EUDEV=y
BR2_TARGET_GENERIC_ROOT_PASSWD="superduperbird"
BR2_TARGET_GENERIC_GETTY_PORT="ttyGS0"
BR2_ROOTFS_OVERLAY="$(BR2_EXTERNAL_SUPERDUPERBIRD_PATH)/board/rootfs-overlay"
BR2_ROOTFS_POST_BUILD_SCRIPT="$(BR2_EXTERNAL_SUPERDUPERBIRD_PATH)/board/post_build.sh"
BR2_ROOTFS_POST_IMAGE_SCRIPT="$(BR2_EXTERNAL_SUPERDUPERBIRD_PATH)/board/post_image.sh"
BR2_LINUX_KERNEL=y
BR2_LINUX_KERNEL_CUSTOM_GIT=y
BR2_LINUX_KERNEL_CUSTOM_REPO_URL="https://github.com/nd-0r/kernel-common.git"
BR2_LINUX_KERNEL_CUSTOM_REPO_VERSION="buildroot-openlinux-201904-g12a"
BR2_LINUX_KERNEL_CUSTOM_REPO_GIT_SUBMODULES=y
BR2_LINUX_KERNEL_USE_CUSTOM_CONFIG=y
BR2_LINUX_KERNEL_CUSTOM_CONFIG_FILE="$(BR2_EXTERNAL_SUPERDUPERBIRD_PATH)/board/linux.config"
BR2_LINUX_KERNEL_ZSTD=y
BR2_PACKAGE_LINUX_TOOLS_PERF=y
BR2_PACKAGE_GDB=y
BR2_PACKAGE_STRACE=y
BR2_PACKAGE_VALGRIND=y
BR2_PACKAGE_KMSCUBE=y
BR2_PACKAGE_MESA3D_DEMOS=y
BR2_PACKAGE_MESA3D=y
BR2_PACKAGE_MESA3D_OSMESA_GALLIUM=y
BR2_PACKAGE_MESA3D_OPENGL_EGL=y
BR2_PACKAGE_MESA3D_OPENGL_ES=y
BR2_PACKAGE_SDL2=y
BR2_PACKAGE_EUDEV_RULES_GEN=y
BR2_PACKAGE_LIBXKBCOMMON_TOOLS=y
BR2_PACKAGE_GOOGLEFONTDIRECTORY=y
BR2_PACKAGE_AVAHI=y
BR2_PACKAGE_AVAHI_DAEMON=y
BR2_PACKAGE_AVAHI_LIBDNSSD_COMPATIBILITY=y
BR2_PACKAGE_AVAHI_DEFAULT_SERVICES=y
BR2_PACKAGE_OPENSSH=y
BR2_PACKAGE_UTIL_LINUX_MOUNT=y
BR2_PACKAGE_HOST_BTRFS_PROGS=y
BR2_PACKAGE_HOST_E2FSPROGS=y
BR2_PACKAGE_HOST_SQUASHFS=y
BR2_PACKAGE_MEMORYGAME=y
```

## package/libffi-old/Config.in
```kconfig
config BR2_PACKAGE_LIBFFI_OLD
	bool "libffi-old"
	depends on BR2_TOOLCHAIN_HAS_THREADS
	help
	  The libffi library provides a portable, high level
	  programming interface to various calling conventions. This
	  allows a programmer to call any function specified by a call
	  interface description at run-time.

	  http://sourceware.org/libffi/

comment "libffi old needs a toolchain w/ threads"
	depends on !BR2_TOOLCHAIN_HAS_THREADS
```

## package/libmali/Config.in
```kconfig
menuconfig BR2_PACKAGE_LIBMALI
	bool "libmali"
	depends on !BR2_STATIC_LIBS
	select BR2_PACKAGE_LIBDRM
	select BR2_PACKAGE_HAS_LIBGBM if !BR2_PACKAGE_LIBGLVND
	select BR2_PACKAGE_LIBGBM_HAS_FEATURE_FORMAT_MODIFIER_PLANE_COUNT
	select BR2_PACKAGE_LIBGBM_HAS_FEATURE_DMA_BUF
	select BR2_PACKAGE_HAS_LIBEGL if !BR2_PACKAGE_LIBGLVND
	select BR2_PACKAGE_LIBGLVND_DISPATCH_EGL if BR2_PACKAGE_LIBGLVND
	select BR2_PACKAGE_HAS_LIBGLES if !BR2_PACKAGE_LIBGLVND
	select BR2_PACKAGE_LIBGLVND_DISPATCH_GLES if BR2_PACKAGE_LIBGLVND
	select BR2_PACKAGE_HAS_LIBEGL_WAYLAND
	help
	  Install GBM, EGL, and OpenGLES provided
	    by `libMali.so` from
		`https://github.com/vaxpl/arm-gpu-mali/tree/master`.

	  Requires `mali.ko` kernel module to be
	    installed and loaded.

if BR2_PACKAGE_LIBMALI

config BR2_PACKAGE_PROVIDES_LIBGBM
	default "libmali"

config BR2_PACKAGE_PROVIDES_LIBEGL
	default "libmali" if !BR2_PACKAGE_LIBGLVND

config BR2_PACKAGE_PROVIDES_LIBGLES
	default "libmali" if !BR2_PACKAGE_LIBGLVND

endif # BR2_PACKAGE_LIBMALI

comment "libmali needs dynamic library"
	depends on BR2_STATIC_LIBS
```

## package/memory-game/Config.in
```kconfig
config BR2_PACKAGE_MEMORYGAME
	bool "Memory game Slint POC"

	depends on BR2_PACKAGE_HAS_UDEV
	depends on BR2_PACKAGE_HOST_RUSTC_TARGET_ARCH_SUPPORTS
	depends on BR2_PACKAGE_HAS_LIBGBM

	select BR2_PACKAGE_LIBDRM
	select BR2_PACKAGE_HOST_PKGCONF
 	select BR2_PACKAGE_HOST_RUSTC
	select BR2_PACKAGE_LIBINPUT
	select BR2_PACKAGE_LIBXKBCOMMON
	select BR2_PACKAGE_FONTCONFIG

	help
	  A POC app for the Slint framework.

	  https://github.com/nd-0r/slint-demo
```

## package/wayland-old/Config.in
```kconfig
config BR2_PACKAGE_WAYLAND_OLD
	bool "wayland-old"
	depends on !BR2_STATIC_LIBS # dlfcn.h
	depends on BR2_TOOLCHAIN_HAS_THREADS
	select BR2_PACKAGE_LIBFFI_OLD
	select BR2_PACKAGE_EXPAT
	help
	  Wayland is a project to define a protocol for a compositor
	  to talk to its clients as well as a library implementation
	  of the protocol.

	  http://wayland.freedesktop.org/

comment "wayland old needs a toolchain w/ threads, dynamic library"
	depends on !BR2_TOOLCHAIN_HAS_THREADS || BR2_STATIC_LIBS
```
